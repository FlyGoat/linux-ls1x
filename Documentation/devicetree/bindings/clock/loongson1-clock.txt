## Documentation/devicetree/bindings/clock/loongson1-clock.txt
```
* Clock bindings for Loongson-1 MCUs

Required properties:
- compatible: Should be "loongson,ls1c-clock" or "loongson,ls1b-clock"
- reg: Address and length of the register set
- #clock-cells: Should be <1>
- clocks: list of input clocks

The clock consumer should specify the desired clock by having the clock
ID in its "clocks" phandle cell. See include/dt-bindings/clock/ls1c-clock.h
or include/dt-bindings/clock/ls1b-clock.h for the full list of clocks.
```

## Documentation/devicetree/bindings/gpio/loongson,ls1x-gpio.txt
```
Loongson-1 GPIO controller

Required properties:
- compatible: "loongson,ls1b-gpio" or "loongson,ls1c-gpio"
- reg: Physical base address and length of the controller's registers.
- gpio-controller: Marks the device node as a GPIO controller.
- #gpio-cells: Should be <1>.

Example:

	GPIO: gpio@1fd010c0 {
		#gpio-cells = <2>;
		compatible = "loongson,ls1b-gpio";
		reg = <0x1fd010c0 0x40>;
		gpio-controller;
	}
```

## arch/mips/loongson32/Kconfig
```kconfig
# SPDX-License-Identifier: GPL-2.0
if MACH_LOONGSON32

choice
	prompt "Machine Type"

config LOONGSON1_LS1B
	bool "Loongson LS1B board"
	select CEVT_R4K if !MIPS_EXTERNAL_TIMER
	select CSRC_R4K if !MIPS_EXTERNAL_TIMER
	select SYS_HAS_CPU_LOONGSON1B
	select DMA_NONCOHERENT
	select BOOT_ELF32
	select IRQ_MIPS_CPU
	select SYS_SUPPORTS_32BIT_KERNEL
	select SYS_SUPPORTS_LITTLE_ENDIAN
	select SYS_SUPPORTS_HIGHMEM
	select COMMON_CLK

config LOONGSON1_LS1C
	bool "Loongson LS1C board"
	select CEVT_R4K if !MIPS_EXTERNAL_TIMER
	select CSRC_R4K if !MIPS_EXTERNAL_TIMER
	select SYS_HAS_CPU_LOONGSON1C
	select SYS_HAS_CPU_MIPS32_R2
	select DMA_NONCOHERENT
	select BOOT_ELF32
	select SYS_SUPPORTS_32BIT_KERNEL
	select SYS_SUPPORTS_LITTLE_ENDIAN
	select SYS_SUPPORTS_HIGHMEM
	select COMMON_CLK
	select LOONGSON1_IRQ
	select IRQ_MIPS_CPU
	select BUILTIN_DTB
	select USE_OF
	select LIBFDT
endchoice

menuconfig LS1X_EARLY_PRINTK
	bool "Earlyprintk Support"
	default Y
	select SYS_HAS_EARLY_PRINTK
	select USE_GENERIC_EARLY_PRINTK_8250
	depends on CPU_LOONGSON1
	help
	  This option enable eralypritk for ls1x.
	  If unsure, say Y.

choice
	prompt  "Select Earlyprintk UART"
	depends on LS1X_EARLY_PRINTK
	default EARLY_USE_UART2

config EARLY_USE_UART0
	bool "Use UART0"
	help
	  Use UART0 as earlyprintk output.

config EARLY_USE_UART1
	bool "Use UART1"
	help
	  Use UART2 as earlyprintk output.

config EARLY_USE_UART2
	bool "Use UART2"
	help
	  Use UART2 as earlyprintk output.

config EARLY_USE_UART3
	bool "Use UART3"
	help
	  Use UART3 as earlyprintk output.

endchoice

menuconfig CEVT_CSRC_LS1X
	bool "Use PWM Timer for clockevent/clocksource"
	select MIPS_EXTERNAL_TIMER
	depends on CPU_LOONGSON1
	help
	  This option changes the default clockevent/clocksource to PWM Timer,
	  and is required by Loongson1 CPUFreq support.

	  If unsure, say N.

choice
	prompt  "Select clockevent/clocksource"
	depends on CEVT_CSRC_LS1X
	default TIMER_USE_PWM0

config TIMER_USE_PWM0
	bool "Use PWM Timer 0"
	help
	  Use PWM Timer 0 as the default clockevent/clocksourcer.

config TIMER_USE_PWM1
	bool "Use PWM Timer 1"
	help
	  Use PWM Timer 1 as the default clockevent/clocksourcer.

config TIMER_USE_PWM2
	bool "Use PWM Timer 2"
	help
	  Use PWM Timer 2 as the default clockevent/clocksourcer.

config TIMER_USE_PWM3
	bool "Use PWM Timer 3"
	help
	  Use PWM Timer 3 as the default clockevent/clocksourcer.

endchoice

endif # MACH_LOONGSON32
```

## drivers/clk/loongson1/Kconfig
```kconfig
menu "Loongson-1 Clock drivers"
	depends on MACH_LOONGSON32

config LOONGSON1_CLOCK_COMMON
	bool

config LOONGSON1_CLOCK_LS1B
	bool "Loongson 1B driver"
	default y
	select LOONGSON1_CLOCK_COMMON
	help
	  Support the clocks provided by the clock hardware on Loongson-1B
	  and compatible SoCs.

	  If building for a Loongson-1B SoC, you want to say Y here.

config LOONGSON1_CLOCK_LS1C
	bool "Loongson 1C driver"
	default y
	select LOONGSON1_CLOCK_COMMON
	help
	  Support the clocks provided by the clock hardware on Loongson-1C
	  and compatible SoCs.

	  If building for a Loongson-1C SoC, you want to say Y here.

endmenu
```
